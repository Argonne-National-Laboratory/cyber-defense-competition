## 2017/ICS/HMI files/PyOPC-Clients-Servers/servers/cpscdc/Config.in
```kconfig
source "$BR2_EXTERNAL/package/python-pyopc/Config.in"
source "$BR2_EXTERNAL/package/python-zsi/Config.in"
```

## 2017/ICS/HMI files/PyOPC-Clients-Servers/servers/cpscdc/configs/pump4_defconfig
```kconfig
BR2_x86_i686=y
BR2_TOOLCHAIN_BUILDROOT_LOCALE=y
BR2_TOOLCHAIN_BUILDROOT_CXX=y
BR2_TARGET_GENERIC_HOSTNAME="opc"
BR2_TARGET_GENERIC_ISSUE=""
BR2_TARGET_GENERIC_ROOT_PASSWD="opc"
BR2_SYSTEM_DHCP="eth0"
BR2_TARGET_TZ_INFO=y
BR2_TARGET_LOCALTIME="America/Chicago"
BR2_ROOTFS_OVERLAY="${BR2_EXTERNAL}/board/pump_station_4/rootfs-overlay"
BR2_ROOTFS_POST_IMAGE_SCRIPT="${BR2_EXTERNAL}/board/opc/scripts/build_vmdk"
BR2_LINUX_KERNEL=y
BR2_LINUX_KERNEL_USE_CUSTOM_CONFIG=y
BR2_LINUX_KERNEL_CUSTOM_CONFIG_FILE="${BR2_EXTERNAL}/board/linux.config"
BR2_LINUX_KERNEL_INSTALL_TARGET=y
BR2_PACKAGE_PYTHON=y
BR2_PACKAGE_PYTHON_PY_PYC=y
BR2_PACKAGE_PYTHON_HTTPLIB2=y
BR2_PACKAGE_PYTHON_NUMPY=y
BR2_PACKAGE_PYTHON_SETUPTOOLS=y
BR2_PACKAGE_PYTHON_TWISTED=y
BR2_PACKAGE_EXPAT=y
BR2_PACKAGE_LIBXML2=y
BR2_PACKAGE_IPTABLES=y
BR2_PACKAGE_OPENSSH=y
BR2_TARGET_ROOTFS_EXT2=y
BR2_TARGET_ROOTFS_EXT2_4=y
# BR2_TARGET_ROOTFS_TAR is not set
BR2_TARGET_GRUB2=y
BR2_PACKAGE_PYTHON_PYOPC=y
BR2_PACKAGE_PYTHON_ZSI=y
BR2_PACKAGE_PYXML=y
```

## 2017/ICS/HMI files/PyOPC-Clients-Servers/servers/cpscdc/package/python-pyopc/Config.in
```kconfig
config BR2_PACKAGE_PYTHON_PYOPC
    bool "python-pyopc"
    help
        Python PyOPC Library to to communicate the OPC protocol

        http://pyopc.sourceforge.net/
```

## 2017/ICS/HMI files/PyOPC-Clients-Servers/servers/cpscdc/package/python-zsi/Config.in
```kconfig
config BR2_PACKAGE_PYTHON_ZSI
    bool "python-zsi"
    help
        Python ZSI

        https://pypi.python.org/pypi/ZSI/
```
